## firmware/inmp441_poc/main/Kconfig.projbuild
```kconfig
menu "Jarvis INMP441 proof of concept"

config JARVIS_MIC_WS_PIN
    int "INMP441 WS GPIO"
    default 15

config JARVIS_MIC_SD_PIN
    int "INMP441 SD GPIO"
    default 16

config JARVIS_MIC_SCK_PIN
    int "INMP441 SCK GPIO"
    default 17

config JARVIS_MIC_RIGHT_CHANNEL
    bool "INMP441 L/R conectado a 3.3 V (canal derecho)"
    default n

config JARVIS_VAD_RMS_THRESHOLD
    int "Umbral RMS inicial para actividad de voz"
    range 50 10000
    default 600

endmenu
```

## firmware/picotts_poc/main/Kconfig.projbuild
```kconfig
menu "Jarvis PicoTTS proof of concept"

config JARVIS_I2S_BCLK_PIN
    int "MAX98357A BCLK GPIO"
    default 40

config JARVIS_I2S_WS_PIN
    int "MAX98357A LRC/WS GPIO"
    default 41

config JARVIS_I2S_DOUT_PIN
    int "MAX98357A DIN GPIO"
    default 42

endmenu
```

## firmware/picotts_poc/sdkconfig.defaults
```kconfig
CONFIG_IDF_TARGET="esp32s3"
CONFIG_ESPTOOLPY_FLASHSIZE_16MB=y
CONFIG_PARTITION_TABLE_CUSTOM=y
CONFIG_PARTITION_TABLE_CUSTOM_FILENAME="partitions.csv"
CONFIG_SPIRAM=y
CONFIG_SPIRAM_MODE_OCT=y
CONFIG_SPIRAM_SPEED_80M=y
CONFIG_ESP_DEFAULT_CPU_FREQ_MHZ_240=y
CONFIG_PICOTTS_LANGUAGE_ES_ES=y
CONFIG_PICOTTS_RESOURCE_MODE_EMBED=y
```
